## YoctoLinuxProject/cyclone5-gsrd-rootfs/conf/bblayers.conf
```bitbake
# POKY_BBLAYERS_CONF_VERSION is increased each time build/conf/bblayers.conf
# changes incompatibly
POKY_BBLAYERS_CONF_VERSION = "2"

BBPATH = "${TOPDIR}"
BBFILES ?= ""

BBLAYERS ?= " \
  /home/adriel/gsrd-socfpga/poky/meta \
  /home/adriel/gsrd-socfpga/poky/meta-poky \
  /home/adriel/gsrd-socfpga/poky/meta-yocto-bsp \
  /home/adriel/gsrd-socfpga/meta-intel-fpga \
  /home/adriel/gsrd-socfpga/meta-intel-fpga-refdes \
  /home/adriel/gsrd-socfpga/meta-openembedded/meta-oe \
  /home/adriel/gsrd-socfpga/meta-openembedded/meta-python \
  /home/adriel/gsrd-socfpga/meta-openembedded/meta-networking \
  /home/adriel/gsrd-socfpga/meta-clang \
  /home/adriel/gsrd-socfpga/meta-de1soc-handoff \
  "
```
